// SPDX-License-Identifier: GPL-2.0-or-later
/*
 * Copyright (C) 2022 PHYTEC Messtechnik GmbH
 * Author: Teresa Remmet <t.remmet@phytec.de>
 */
#include "phycore-imx8mm.dts"

/ {
	model = "PHYTEC phyCORE-i.MX8MM 1532.1";
};

&reg_usdhc2_vmmc {
	/delete-property/ gpio;
};
