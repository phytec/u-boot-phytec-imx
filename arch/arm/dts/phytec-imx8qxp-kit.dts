// SPDX-License-Identifier: GPL-2.0+
/*
 * Copyright (C) 2021 PHYTEC America, LLC
 *
 * This program is free software; you can redistribute it and/or modify
 * it under the terms of the GNU General Public License version 2 as
 * published by the Free Software Foundation.
 *
 *
 * DTS for PHYTEC kit phyCORE-i.MX8X
 */
/dts-v1/;

#include "phytec-imx8qxp-pcm065.dtsi"        /* SOM */
#include "phytec-imx8qxp-pcm942.dtsi"        /* Carrier board */

#include "phytec-imx8qxp-kit-u-boot.dtsi"    /* U-Boot-specific support */
