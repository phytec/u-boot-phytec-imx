## board/phytec/imx8mp-phyflex-libra-rdk/Kconfig
```kconfig
if TARGET_IMX8MP_PHYFLEX_LIBRA_RDK

config SYS_BOARD
	default "imx8mp-phyflex-libra-rdk"

config SYS_VENDOR
	default "phytec"

config IMX_CONFIG
	default "board/phytec/imx8mp-phyflex-libra-rdk/imximage-8mp-sd.cfg"

config SYS_CONFIG_NAME
	default "imx8mp-phyflex-libra-rdk"

config PHYFLEX_IMX8MP_RAM_STATIC_SIZE
	bool "Set phyFLEX-i.MX8MP RAM size static instead of detecting"
	default false
	help
	  RAM size is automatic being detected with the help of
	  the EEPROM introspection data. Set RAM size to a static value
	  during compile time instead.

choice
	prompt "phyFLEX-i.MX8MP RAM size"
	depends on PHYFLEX_IMX8MP_RAM_STATIC_SIZE
	default PHYFLEX_IMX8MP_RAM_SIZE_2GB

config PHYFLEX_IMX8MP_RAM_SIZE_2GB
	bool "2GB RAM"
	help
	  Set RAM size static to 2GB for phyFLEX-i.MX8MP.

config PHYFLEX_IMX8MP_RAM_SIZE_4GB
	bool "4GB RAM"
	help
	  Set RAM size static to 4GB for phyFLEX-i.MX8MP.
endchoice

source "board/phytec/common/Kconfig"
endif
```

## board/phytec/imx95-libra-fpsc/Kconfig
```kconfig
if TARGET_IMX95_LIBRA_FPSC

config SYS_BOARD
	default "imx95-libra-fpsc"

config SYS_VENDOR
	default "phytec"

config SYS_CONFIG_NAME
	default "imx95-libra-fpsc"

endif
```

## board/phytec/imx95-phyflex-libra-rdk/Kconfig
```kconfig
if TARGET_IMX95_PHYFLEX_LIBRA_RDK

config SYS_BOARD
	default "imx95-phyflex-libra-rdk"

config SYS_VENDOR
	default "phytec"

config SYS_CONFIG_NAME
	default "imx95-phyflex-libra-rdk"

endif
```

## board/phytec/phycore_imx8mm/Kconfig
```kconfig
if TARGET_PHYCORE_IMX8MM

config SYS_BOARD
	default "phycore_imx8mm"

config SYS_VENDOR
	default "phytec"

config SYS_CONFIG_NAME
	default "phycore_imx8mm"

config IMX_CONFIG
	default "board/phytec/phycore_imx8mm/imximage-8mm-sd.cfg"

config PHYCORE_IMX8MM_RAM_SIZE_FIX
	bool "Set phyCORE-i.MX8MM RAM size fix instead of detecting"
	default false
	help
	  RAM size is automatic being detected with the help of
	  the EEPROM introspection data. Set RAM size to a fix value
	  instead.

choice
	prompt "phyCORE-i.MX8MM RAM size"
	depends on PHYCORE_IMX8MM_RAM_SIZE_FIX
	default PHYCORE_IMX8MM_RAM_SIZE_2GB

config PHYCORE_IMX8MM_RAM_SIZE_1GB
	bool "1GB RAM"
	help
	  Set RAM size fix to 1GB for phyCORE-i.MX8MM.

config PHYCORE_IMX8MM_RAM_SIZE_2GB
	bool "2GB RAM"
	help
	  Set RAM size fix to 2GB for phyCORE-i.MX8MM.

config PHYCORE_IMX8MM_RAM_SIZE_4GB
	bool "4GB RAM"
	help
	  Set RAM size fix to 4GB for phyCORE-i.MX8MM.
endchoice

config PHYCORE_IMX8MM_RAM_STATIC_SOM_REV
	bool "Set static phyCORE-i.MX8MM SoM revision for RAM timing setup"
	default false
	help
	  phyCORE-i.MX8MM SoM revision 7 uses a updated set of optimized
	  RAM timings compared to revision 6 and older. Set the SoM
	  revision during compile time instead of being detected.

choice
	prompt "phyCORE-i.MX8MM RAM timing SoM revision static config"
	depends on PHYCORE_IMX8MM_RAM_STATIC_SOM_REV
	default PHYCORE_IMX8MM_USE_SOM_REV_7

config PHYCORE_IMX8MM_USE_SOM_REV_6
	bool "RAM Timings for SoM Revisions 6 and older"
	help
	  Use optimized RAM Timings for phyCORE-i.MX8MM SoM Revisions 6
	  and older.

config PHYCORE_IMX8MM_USE_SOM_REV_7
	bool "RAM Timings for SoM Revision 7"
	help
	  Use optimized RAM Timings for phyCORE-i.MX8MM SoM Revision 7.
endchoice

source "board/phytec/common/Kconfig"
endif
```

## board/phytec/phycore_imx91_imx93/Kconfig
```kconfig
if TARGET_PHYCORE_IMX91 || TARGET_PHYCORE_IMX93

config SYS_BOARD
	default "phycore_imx91_imx93"

config SYS_VENDOR
	default "phytec"

config SYS_CONFIG_NAME
	default "phycore_imx91_imx93"

config PHYCORE_IMX91_IMX93_RAM_TYPE_FIX
	bool "Set phyCORE-i.MX91/i.MX93 RAM type and size fix instead of detecting"
	default false
	help
	  RAM type and size is being automatically detected with the help
	  of the PHYTEC EEPROM introspection data.
	  Set RAM type to a fix value instead.

choice
	prompt "phyCORE-i.MX91/i.MX93 RAM type"
	depends on PHYCORE_IMX91_IMX93_RAM_TYPE_FIX
	default PHYCORE_IMX91_IMX93_RAM_TYPE_LPDDR4X_1GB

config PHYCORE_IMX91_IMX93_RAM_TYPE_LPDDR4X_1GB
	bool "LPDDR4X 1GB RAM"
	help
	  Set LPDDR4(X) type and 1GB size RAM for phyCORE-i.MX91/i.MX93.

config PHYCORE_IMX91_IMX93_RAM_TYPE_LPDDR4X_2GB
	bool "LPDDR4X 2GB RAM"
	help
	  Set LPDDR4(X) type and 2GB size RAM for phyCORE-i.MX91/i.MX93.

endchoice

source "board/phytec/common/Kconfig"
endif
```

## board/phytec/phyflex_imx91_93/Kconfig
```kconfig
if TARGET_PHYFLEX_IMX91 || TARGET_PHYFLEX_IMX93

config SYS_BOARD
	default "phyflex_imx91_93"

config SYS_VENDOR
	default "phytec"

config SYS_CONFIG_NAME
	default "phyflex_imx91_93"

config PHYFLEX_IMX91_93_RAM_STATIC
	bool "Set phyFLEX-i.MX91/93 RAM type and size fix instead of detecting"
	default false
	help
	  RAM type and size is being automatically detected with the help
	  of the PHYTEC EEPROM introspection data.
	  Set RAM size to a fix value instead.

choice
	prompt "phyFLEX-i.MX91/93 RAM type"
	depends on PHYFLEX_IMX91_93_RAM_STATIC
	default PHYFLEX_IMX91_93_RAM_LPDDR4X_1GB

config PHYFLEX_IMX91_93_RAM_LPDDR4X_1GB
	bool "LPDDR4X 1GB RAM"
	help
	  Set RAM type fixed to LPDDR4X and RAM size fixed to 1GB
	  for phyFLEX-i.MX91/93.

config PHYFLEX_IMX91_93_RAM_LPDDR4X_2GB
	bool "LPDDR4X 2GB RAM"
	help
	  Set RAM type fixed to LPDDR4X and RAM size fixed to 2GB
	  for phyFLEX-i.MX91/93.

endchoice

source "board/phytec/common/Kconfig"
endif
```
