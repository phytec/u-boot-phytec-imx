## board/phytec/common/Kconfig
```kconfig
config PHYTEC_SOM_DETECTION
	bool "Support SoM detection for PHYTEC platforms"
	select SPL_CRC8 if SPL
	help
	   Support of I2C EEPROM based SoM detection.

config PHYTEC_SOM_DETECTION_BLOCKS
	bool "Extend SoM detection with block support"
	depends on PHYTEC_SOM_DETECTION
	help
	   Extend the I2C EEPROM based SoM detection with API v3. This API
	   introduces blocks with different payloads.

config PHYTEC_IMX8M_SOM_DETECTION
	bool "Support SoM detection for i.MX8M PHYTEC platforms"
	depends on ARCH_IMX8M && PHYTEC_SOM_DETECTION
	default y
	help
	  Support of I2C EEPROM based SoM detection. Supported
	  for PHYTEC i.MX8MM/i.MX8MP boards

config PHYTEC_IMX93_SOM_DETECTION
	bool "Support SoM detection for i.MX93 PHYTEC platforms"
	depends on ARCH_IMX9 && PHYTEC_SOM_DETECTION
	default y
	help
	  Support of I2C EEPROM based SoM detection. Supported
	  for PHYTEC i.MX93 based boards
```

## board/phytec/imx8mp-libra-fpsc/Kconfig
```kconfig
if TARGET_IMX8MP_LIBRA_FPSC

config SYS_BOARD
	default "imx8mp-libra-fpsc"

config SYS_VENDOR
	default "phytec"

config IMX_CONFIG
	default "board/phytec/phycore_imx8mp/imximage-8mp-sd.cfg"

config SYS_CONFIG_NAME
	default "imx8mp-libra-fpsc"

source "board/phytec/common/Kconfig"
endif
```

## board/phytec/pcl066/Kconfig
```kconfig
if TARGET_IMX8MQ_PCL066

config SYS_BOARD
	default "pcl066"

config SYS_VENDOR
	default "phytec"

config SYS_CONFIG_NAME
	default "pcl066"

source "board/freescale/common/Kconfig"

endif
```

## board/phytec/pcm064/Kconfig
```kconfig
if TARGET_IMX8QM_PCM064

config SYS_BOARD
	default "pcm064"

config SYS_VENDOR
	default "phytec"

config SYS_CONFIG_NAME
	default "pcm064"

endif
```

## board/phytec/pcm065/Kconfig
```kconfig
if TARGET_IMX8QXP_PCM065

config SYS_BOARD
	default "pcm065"

config SYS_VENDOR
	default "phytec"

config SYS_CONFIG_NAME
	default "pcm065"

source "board/phytec/common/Kconfig"

endif
```

## board/phytec/phycore_imx7/Kconfig
```kconfig
if TARGET_PHYCORE_IMX7

config SYS_BOARD
	default "phycore_imx7"

config SYS_VENDOR
	default "phytec"

config SYS_CONFIG_NAME
	default "phycore_imx7"

config SYS_TEXT_BASE
	default 0x87800000

endif
```

## board/phytec/phycore_imx8mn/Kconfig
```kconfig
if TARGET_PHYCORE_IMX8MN
config SYS_BOARD
	default "phycore_imx8mn"

config SYS_VENDOR
	default "phytec"

config SYS_CONFIG_NAME
	default "phycore_imx8mn"

config PHYCORE_IMX8MN_RAM_SIZE_FIX
	bool "Set phyCORE-i.MX8MN RAM size fix instead of detecting"
	default false
	help
	  RAM size is automatic being detected with the help of
	  the EEPROM introspection data. Set RAM size to a fix value
	  instead.

choice
	prompt "phyCORE-i.MX8MN RAM size"
	depends on PHYCORE_IMX8MN_RAM_SIZE_FIX
	default PHYCORE_IMX8MN_RAM_SIZE_1GB

config PHYCORE_IMX8MN_RAM_SIZE_1GB
	bool "1GB RAM"
	help
	  Set RAM size fix to 1GB for phyCORE-i.MX8MN.

endchoice

source "board/phytec/common/Kconfig"

endif
```

## board/phytec/phycore_imx8mp/Kconfig
```kconfig
if TARGET_PHYCORE_IMX8MP

config SYS_BOARD
	default "phycore_imx8mp"

config SYS_VENDOR
	default "phytec"

config SYS_CONFIG_NAME
	default "phycore_imx8mp"

config PHYCORE_IMX8MP_RAM_SIZE_FIX
	bool "Set phyCORE-i.MX8MP RAM size fix instead of detecting"
	default false
	help
	  RAM size is automatic being detected with the help of
	  the EEPROM introspection data. Set RAM size to a fix value
	  instead.

choice
	prompt "phyCORE-i.MX8MP RAM size"
	depends on PHYCORE_IMX8MP_RAM_SIZE_FIX
	default PHYCORE_IMX8MP_RAM_SIZE_2GB

config PHYCORE_IMX8MP_RAM_SIZE_1GB
	bool "1GB RAM"
	help
	  Set RAM size fix to 1GB for phyCORE-i.MX8MP.

config PHYCORE_IMX8MP_RAM_SIZE_2GB
	bool "2GB RAM"
	help
	  Set RAM size fix to 2GB for phyCORE-i.MX8MP.

config PHYCORE_IMX8MP_RAM_SIZE_4GB
	bool "4GB RAM"
	help
	  Set RAM size fix to 4GB for phyCORE-i.MX8MP.
endchoice

source "board/phytec/common/Kconfig"
endif
```

## board/phytec/phycore_imx8mq/Kconfig
```kconfig
if TARGET_PHYCORE_IMX8MQ

config SYS_BOARD
	default "phycore_imx8mq"

config SYS_VENDOR
	default "phytec"

config SYS_CONFIG_NAME
	default "phycore_imx8mq"

endif
```

## board/phytec/phycore_imx8qm/Kconfig
```kconfig
if TARGET_PHYCORE_IMX8QM

config SYS_BOARD
	default "phycore_imx8qm"

config SYS_VENDOR
	default "phytec"

config SYS_CONFIG_NAME
	default "phycore_imx8qm"

endif
```

## board/phytec/phycore_imx8x/Kconfig
```kconfig
if TARGET_PHYCORE_IMX8X

config SYS_BOARD
	default "phycore_imx8x"

config SYS_VENDOR
	default "phytec"

config SYS_CONFIG_NAME
	default "phycore_imx8x"

config IMX_CONFIG
	default "board/phytec/phycore_imx8x/imximage.cfg"

source "board/phytec/common/Kconfig"

endif
```

## board/phytec/phycore_imx93/Kconfig
```kconfig
if TARGET_PHYCORE_IMX93

config SYS_BOARD
	default "phycore_imx93"

config SYS_VENDOR
	default "phytec"

config SYS_CONFIG_NAME
	default "phycore_imx93"

config PHYCORE_IMX93_RAM_TYPE_FIX
	bool "Set phyCORE-i.MX93 RAM type and size fix instead of detecting"
	default false
	help
	  RAM type and size is being automaticly detected with the help
	  of the PHYTEC EEPROM introspection data.
	  Set RAM type to a fix value instead.

choice
	prompt "phyCORE-i.MX93 RAM type"
	depends on PHYCORE_IMX93_RAM_TYPE_FIX
	default PHYCORE_IMX93_RAM_TYPE_LPDDR4X_1GB

config PHYCORE_IMX93_RAM_TYPE_LPDDR4X_1GB
	bool "LPDDR4X 1GB RAM"
	help
	  Set LPDDR4X type and 1GB size RAM for phyCORE-i.MX93.

config PHYCORE_IMX93_RAM_TYPE_LPDDR4X_2GB
	bool "LPDDR4X 2GB RAM"
	help
	  Set LPDDR4X type and 2GB size RAM for phyCORE-i.MX93.

endchoice

source "board/phytec/common/Kconfig"
endif
```

## configs/pcl066_defconfig
```kconfig
CONFIG_ARM=y
CONFIG_ARCH_IMX8M=y
CONFIG_SYS_TEXT_BASE=0x40200000
CONFIG_SYS_MALLOC_F_LEN=0x2000
CONFIG_TARGET_IMX8MQ_PCL066=y
CONFIG_SPL_SERIAL_SUPPORT=y
CONFIG_SPL=y
CONFIG_NR_DRAM_BANKS=1
CONFIG_FIT=y
CONFIG_SPL_LOAD_FIT=y
CONFIG_SYS_EXTRA_OPTIONS="IMX_CONFIG=arch/arm/mach-imx/imx8m/imximage.cfg"
CONFIG_ARCH_MISC_INIT=y
CONFIG_HUSH_PARSER=y
CONFIG_CMD_GPIO=y
CONFIG_CMD_I2C=y
CONFIG_CMD_CACHE=y
CONFIG_CMD_PMIC=y
CONFIG_CMD_REGULATOR=y
CONFIG_CMD_EXT2=y
CONFIG_CMD_EXT4=y
CONFIG_CMD_EXT4_WRITE=y
CONFIG_CMD_FAT=y
CONFIG_EFI_PARTITION=y
CONFIG_OF_CONTROL=y
CONFIG_DEFAULT_DEVICE_TREE="phytec-phycore-imx8mq"
CONFIG_ENV_IS_IN_MMC=y
CONFIG_NET_RANDOM_ETHADDR=y
CONFIG_SAVED_DRAM_TIMING_BASE=0x40000000
CONFIG_DM_GPIO=y
CONFIG_DM_I2C=y
CONFIG_SYS_I2C_MXC=y
CONFIG_MISC=y
CONFIG_I2C_EEPROM=y
CONFIG_DM_MMC=y
CONFIG_PHY_TI=y
CONFIG_DM_ETH=y
CONFIG_ETH_DESIGNWARE=y
CONFIG_FEC_MXC=y
CONFIG_PINCTRL=y
CONFIG_PINCTRL_IMX8M=y
CONFIG_DM_PMIC=y
CONFIG_DM_PMIC_PFUZE100=y
CONFIG_DM_REGULATOR=y
CONFIG_DM_REGULATOR_PFUZE100=y
CONFIG_DM_REGULATOR_FIXED=y
CONFIG_DM_REGULATOR_GPIO=y
CONFIG_DM_THERMAL=y
CONFIG_NXP_TMU=y
```

## configs/phycore-imx7_spl_defconfig
```kconfig
CONFIG_ARM=y
CONFIG_ARCH_MX7=y
CONFIG_SPL_GPIO=y
CONFIG_SPL_LIBCOMMON_SUPPORT=y
CONFIG_SPL_LIBGENERIC_SUPPORT=y
CONFIG_NR_DRAM_BANKS=1
CONFIG_SYS_MEMTEST_START=0x80000000
CONFIG_SYS_MEMTEST_END=0xA0000000
CONFIG_ENV_SIZE=0x2000
CONFIG_ENV_OFFSET=0xE0000
CONFIG_SYS_I2C_MXC_I2C1=y
CONFIG_DM_GPIO=y
CONFIG_DEFAULT_DEVICE_TREE="imx7s-phyboard-zeta"
CONFIG_TARGET_PHYCORE_IMX7=y
CONFIG_PCM_061_SPL_DDR3_1V5=y
CONFIG_SPL_MMC=y
CONFIG_SPL_SERIAL=y
CONFIG_SPL=y
CONFIG_ARMV7_BOOT_SEC_DEFAULT=y
CONFIG_IMX_RDC=y
CONFIG_IMX_BOOTAUX=y
# CONFIG_CMD_BMODE is not set
CONFIG_OPTIMIZE_INLINING=y
CONFIG_FIT=y
CONFIG_SPL_LOAD_FIT=y
CONFIG_BOOTDELAY=3
CONFIG_SYS_CONSOLE_IS_IN_ENV=y
CONFIG_SPL_BOARD_INIT=y
CONFIG_SPL_I2C=y
CONFIG_SPL_POWER=y
CONFIG_HUSH_PARSER=y
CONFIG_CMD_BOOTZ=y
# CONFIG_CMD_IMI is not set
# CONFIG_CMD_XIMG is not set
CONFIG_CMD_MEMTEST=y
CONFIG_CMD_DFU=y
CONFIG_CMD_GPIO=y
CONFIG_CMD_I2C=y
CONFIG_CMD_LSBLK=y
CONFIG_CMD_MMC=y
CONFIG_CMD_USB=y
CONFIG_CMD_DHCP=y
CONFIG_CMD_MII=y
CONFIG_CMD_PING=y
CONFIG_CMD_CACHE=y
CONFIG_CMD_REGULATOR=y
CONFIG_CMD_EXT2=y
CONFIG_CMD_EXT4=y
CONFIG_CMD_EXT4_WRITE=y
CONFIG_CMD_FAT=y
CONFIG_CMD_FS_GENERIC=y
CONFIG_OF_CONTROL=y
CONFIG_OF_LIST="imx7d-phyboard-zeta imx7s-phyboard-zeta-nand imx7s-phyboard-zeta"
CONFIG_NET_RANDOM_ETHADDR=y
CONFIG_DFU_MMC=y
CONFIG_DFU_RAM=y
CONFIG_DM_74X164=y
CONFIG_DM_I2C=y
CONFIG_SPL_SYS_I2C_LEGACY=y
CONFIG_SYS_I2C_MXC=y
CONFIG_MMC_IO_VOLTAGE=y
CONFIG_MMC_UHS_SUPPORT=y
CONFIG_MMC_HS200_SUPPORT=y
CONFIG_FSL_USDHC=y
CONFIG_MTD=y
CONFIG_DM_MTD=y
CONFIG_DM_SPI_FLASH=y
CONFIG_SF_DEFAULT_MODE=0
CONFIG_SF_DEFAULT_SPEED=40000000
CONFIG_SPI_FLASH_EON=y
CONFIG_SPI_FLASH_STMICRO=y
CONFIG_SPI_FLASH_MTD=y
CONFIG_PHYLIB=y
CONFIG_PHY_ADIN=y
CONFIG_PHY_BROADCOM=y
CONFIG_PHY_MICREL=y
CONFIG_DM_ETH=y
CONFIG_DM_ETH_PHY=y
CONFIG_FEC_MXC=y
CONFIG_RGMII=y
CONFIG_MII=y
CONFIG_PINCTRL=y
CONFIG_PINCTRL_IMX7=y
CONFIG_POWER_LEGACY=y
CONFIG_DM_REGULATOR=y
CONFIG_DM_REGULATOR_FIXED=y
CONFIG_DM_REGULATOR_GPIO=y
CONFIG_POWER_I2C=y
CONFIG_DM_PWM=y
CONFIG_DM_SERIAL=y
CONFIG_MXC_UART=y
CONFIG_SPI=y
CONFIG_DM_SPI=y
CONFIG_FSL_QSPI=y
CONFIG_USB=y
CONFIG_USB_EHCI_HCD=y
CONFIG_MXC_USB_OTG_HACTIVE=y
CONFIG_USB_STORAGE=y
CONFIG_USB_GADGET=y
CONFIG_CI_UDC=y
CONFIG_USB_GADGET_DOWNLOAD=y
CONFIG_ERRNO_STR=y
CONFIG_OF_LIBFDT_OVERLAY=y
```

## configs/phycore-imx8mm_defconfig
```kconfig
CONFIG_ARM=y
CONFIG_ARCH_IMX8M=y
CONFIG_SYS_TEXT_BASE=0x40200000
CONFIG_SYS_MALLOC_F_LEN=0x2000
CONFIG_TARGET_PHYCORE_IMX8MM=y
CONFIG_SPL_MMC_SUPPORT=y
CONFIG_SPL_SERIAL_SUPPORT=y
CONFIG_SPL=y
CONFIG_SMBIOS_PRODUCT_NAME="imx8mm_evk"
CONFIG_NR_DRAM_BANKS=1
CONFIG_FIT=y
CONFIG_FIT_EXTERNAL_OFFSET=0x3000
CONFIG_SPL_LOAD_FIT=y
CONFIG_SPL_FIT_GENERATOR="arch/arm/mach-imx/mkimage_fit_atf.sh"
CONFIG_SYS_EXTRA_OPTIONS="IMX_CONFIG=arch/arm/mach-imx/imx8m/imximage.cfg,SPL_TEXT_BASE=0x7E1000"
CONFIG_CONSOLE_MUX=y
CONFIG_DEFAULT_FDT_FILE="phytec-imx8mm-phyboard-polis-rdk.dtb"
CONFIG_ARCH_MISC_INIT=y
CONFIG_SPL_BOARD_INIT=y
CONFIG_SPL_USB_HOST_SUPPORT=y
CONFIG_SPL_USB_GADGET=y
CONFIG_SPL_USB_SDP_SUPPORT=y
CONFIG_HUSH_PARSER=y
CONFIG_CMD_EEPROM=y
CONFIG_CMD_MEMTEST=y
CONFIG_CMD_GPIO=y
CONFIG_CMD_I2C=y
CONFIG_CMD_SF=y
CONFIG_CMD_CACHE=y
CONFIG_CMD_REGULATOR=y
CONFIG_CMD_EXT2=y
CONFIG_CMD_EXT4=y
CONFIG_CMD_EXT4_WRITE=y
CONFIG_CMD_FAT=y
CONFIG_EFI_PARTITION=y
CONFIG_OF_CONTROL=y
CONFIG_DEFAULT_DEVICE_TREE="fsl-imx8mm-evk"
CONFIG_ENV_IS_IN_MMC=y
CONFIG_USB_FUNCTION_FASTBOOT=y
CONFIG_FASTBOOT_BUF_ADDR=0x42800000
CONFIG_FASTBOOT_BUF_SIZE=0x40000000
CONFIG_FASTBOOT_FLASH=y
CONFIG_DM_GPIO=y
CONFIG_DM_I2C=y
CONFIG_SYS_I2C_MXC=y
CONFIG_MISC=y
CONFIG_I2C_EEPROM=y
CONFIG_SYS_I2C_EEPROM_ADDR=0x51
CONFIG_SYS_EEPROM_SIZE=4096
CONFIG_SYS_EEPROM_PAGE_WRITE_BITS=5
CONFIG_SYS_EEPROM_PAGE_WRITE_DELAY_MS=5
CONFIG_SYS_I2C_EEPROM_ADDR_LEN=2
CONFIG_SYS_I2C_EEPROM_ADDR_OVERFLOW=0x0
CONFIG_DM_MMC=y
CONFIG_DM_SPI_FLASH=y
CONFIG_SPI_FLASH=y
CONFIG_SF_DEFAULT_MODE=0
CONFIG_SF_DEFAULT_SPEED=40000000
CONFIG_SPI_FLASH_BAR=y
CONFIG_SPI_FLASH_STMICRO=y
CONFIG_PHYLIB=y
CONFIG_PHY_TI=y
CONFIG_DM_ETH=y
CONFIG_FEC_MXC=y
CONFIG_PINCTRL=y
CONFIG_PINCTRL_IMX8M=y
CONFIG_DM_REGULATOR=y
CONFIG_DM_REGULATOR_FIXED=y
CONFIG_DM_REGULATOR_GPIO=y
CONFIG_SPI=y
CONFIG_DM_SPI=y
CONFIG_FSL_FSPI=y
CONFIG_DM_THERMAL=y
CONFIG_NXP_TMU=y
CONFIG_USB=y
CONFIG_DM_USB=y
CONFIG_USB_EHCI_HCD=y
CONFIG_USB_GADGET=y
CONFIG_USB_GADGET_MANUFACTURER="FSL"
CONFIG_USB_GADGET_VENDOR_NUM=0x0525
CONFIG_USB_GADGET_PRODUCT_NUM=0xa4a5
CONFIG_SDP_LOADADDR=0x40400000
CONFIG_SMBIOS_MANUFACTURER="freescale"
```

## configs/phycore-imx8mm_fspi_defconfig
```kconfig
CONFIG_ARM=y
CONFIG_ARCH_IMX8M=y
CONFIG_SYS_TEXT_BASE=0x40200000
CONFIG_SPL_GPIO_SUPPORT=y
CONFIG_SPL_LIBCOMMON_SUPPORT=y
CONFIG_SPL_LIBGENERIC_SUPPORT=y
CONFIG_SYS_MALLOC_F_LEN=0x10000
CONFIG_SYS_I2C_MXC_I2C1=y
CONFIG_SYS_I2C_MXC_I2C2=y
CONFIG_SYS_I2C_MXC_I2C3=y
CONFIG_ENV_SIZE=0x10000
CONFIG_ENV_SECT_SIZE=0x10000
CONFIG_ENV_OFFSET=0x400000
CONFIG_DM_GPIO=y
CONFIG_TARGET_PHYCORE_IMX8MM=y
CONFIG_SPL_MMC_SUPPORT=y
CONFIG_SPL_SERIAL_SUPPORT=y
CONFIG_SPL_DRIVERS_MISC_SUPPORT=y
CONFIG_SPL=y
CONFIG_SPL_SPI_FLASH_SUPPORT=y
CONFIG_SPL_SPI_SUPPORT=y
CONFIG_SPL_TEXT_BASE=0x7E2000
CONFIG_FIT=y
CONFIG_FIT_EXTERNAL_OFFSET=0x3000
CONFIG_SPL_LOAD_FIT=y
CONFIG_SPL_FIT_GENERATOR="arch/arm/mach-imx/mkimage_fit_atf.sh"
CONFIG_OF_SYSTEM_SETUP=y
CONFIG_SYS_EXTRA_OPTIONS="IMX_CONFIG=arch/arm/mach-imx/imx8m/imximage-8mm-lpddr4.cfg"
CONFIG_DEFAULT_FDT_FILE="oftree"
CONFIG_BOARD_LATE_INIT=y
CONFIG_SPL_BOARD_INIT=y
CONFIG_SPL_SEPARATE_BSS=y
CONFIG_SPL_HASH_SUPPORT=y
CONFIG_SPL_I2C_SUPPORT=y
CONFIG_SPL_NOR_SUPPORT=y
CONFIG_SPL_POWER_SUPPORT=y
CONFIG_SPL_USB_HOST_SUPPORT=y
CONFIG_SPL_USB_GADGET=y
CONFIG_SPL_USB_SDP_SUPPORT=y
CONFIG_SPL_WATCHDOG_SUPPORT=y
CONFIG_HUSH_PARSER=y
CONFIG_SYS_PROMPT="u-boot=> "
# CONFIG_CMD_EXPORTENV is not set
# CONFIG_CMD_IMPORTENV is not set
# CONFIG_CMD_CRC32 is not set
CONFIG_CMD_EEPROM=y
CONFIG_CMD_FUSE=y
CONFIG_CMD_GPIO=y
CONFIG_CMD_I2C=y
CONFIG_CMD_MMC=y
CONFIG_CMD_DHCP=y
CONFIG_CMD_MII=y
CONFIG_CMD_PING=y
CONFIG_CMD_CACHE=y
CONFIG_CMD_REGULATOR=y
CONFIG_CMD_EXT2=y
CONFIG_CMD_EXT4=y
CONFIG_CMD_EXT4_WRITE=y
CONFIG_CMD_FAT=y
CONFIG_OF_CONTROL=y
CONFIG_DEFAULT_DEVICE_TREE="phycore-imx8mm"
CONFIG_ENV_IS_IN_SPI_FLASH=y
CONFIG_USE_ENV_SPI_BUS=y
CONFIG_ENV_SPI_BUS=0
CONFIG_USE_ENV_SPI_CS=y
CONFIG_ENV_SPI_CS=0
CONFIG_USE_ENV_SPI_MAX_HZ=y
CONFIG_ENV_SPI_MAX_HZ=80000000
CONFIG_USE_ENV_SPI_MODE=y
CONFIG_ENV_SPI_MODE=0x0
CONFIG_SYS_RELOC_GD_ENV_ADDR=y
CONFIG_ENV_VARS_UBOOT_RUNTIME_CONFIG=y
CONFIG_CLK_COMPOSITE_CCF=y
CONFIG_CLK_IMX8MM=y
CONFIG_USB_FUNCTION_FASTBOOT=y
CONFIG_FASTBOOT_BUF_ADDR=0x42800000
CONFIG_FASTBOOT_BUF_SIZE=0x40000000
CONFIG_FASTBOOT_FLASH=y
CONFIG_MXC_GPIO=y
CONFIG_DM_I2C=y
CONFIG_SYS_I2C_MXC=y
CONFIG_MISC=y
CONFIG_I2C_EEPROM=y
CONFIG_SYS_I2C_EEPROM_ADDR=0x51
CONFIG_SYS_EEPROM_SIZE=4096
CONFIG_SYS_EEPROM_PAGE_WRITE_BITS=5
CONFIG_SYS_EEPROM_PAGE_WRITE_DELAY_MS=5
CONFIG_SYS_I2C_EEPROM_ADDR_LEN=2
CONFIG_SYS_I2C_EEPROM_ADDR_OVERFLOW=0x0
CONFIG_DM_MMC=y
CONFIG_SUPPORT_EMMC_BOOT=y
CONFIG_MMC_IO_VOLTAGE=y
CONFIG_MMC_UHS_SUPPORT=y
CONFIG_MMC_HS400_ES_SUPPORT=y
CONFIG_MMC_HS400_SUPPORT=y
CONFIG_FSL_ESDHC_IMX=y
CONFIG_MTD=y
CONFIG_DM_MTD=y
CONFIG_DM_SPI_FLASH=y
CONFIG_SF_DEFAULT_MODE=0x0
CONFIG_SF_DEFAULT_SPEED=80000000
CONFIG_SPI_FLASH_BAR=y
CONFIG_SPI_FLASH_MACRONIX=y
CONFIG_SPI_FLASH_SPANSION=y
CONFIG_SPI_FLASH_STMICRO=y
CONFIG_SPI_FLASH_WINBOND=y
# CONFIG_SPI_FLASH_USE_4K_SECTORS is not set
CONFIG_SPI_FLASH_MTD=y
CONFIG_PHYLIB=y
CONFIG_PHY_TI=y
CONFIG_DM_ETH=y
CONFIG_PHY_GIGE=y
CONFIG_FEC_MXC=y
CONFIG_MII=y
CONFIG_PINCTRL=y
CONFIG_PINCTRL_IMX8M=y
CONFIG_DM_REGULATOR=y
CONFIG_DM_REGULATOR_FIXED=y
CONFIG_DM_REGULATOR_GPIO=y
CONFIG_MXC_UART=y
CONFIG_SPI=y
CONFIG_DM_SPI=y
CONFIG_FSL_FSPI=y
CONFIG_SYSRESET=y
CONFIG_SYSRESET_PSCI=y
CONFIG_DM_THERMAL=y
CONFIG_NXP_TMU=y
CONFIG_USB=y
CONFIG_DM_USB=y
CONFIG_USB_EHCI_HCD=y
CONFIG_USB_GADGET=y
CONFIG_USB_GADGET_MANUFACTURER="FSL"
CONFIG_USB_GADGET_VENDOR_NUM=0x0525
CONFIG_USB_GADGET_PRODUCT_NUM=0xa4a5
CONFIG_CI_UDC=y
CONFIG_SDP_LOADADDR=0x40400000
CONFIG_IMX_WATCHDOG=y
CONFIG_CSF_SIZE=0x2000
```
